## configs/np545xla_defconfig
```kconfig
# NP545XLA kernel configuration
# Samsung Galaxy Book Go 5G (SC8180XP)
#
# Based on defconfig + sc8180x-specific drivers built in.
# Everything critical for boot is =y (not =m) to avoid initrd module loading issues.

# --- Platform ---
CONFIG_ARCH_QCOM=y
CONFIG_ARM64=y
CONFIG_ARM64_4K_PAGES=y
CONFIG_ARM64_VA_BITS_48=y
CONFIG_SCHED_MC=y
CONFIG_SCHED_SMT=y
CONFIG_NUMA=y
CONFIG_COMPAT=y

# --- Qualcomm SC8180X core drivers (BUILT-IN, not modules) ---
CONFIG_COMMON_CLK_SC8180X=y
CONFIG_INTERCONNECT_QCOM_SC8180X=y
CONFIG_QCOM_RPMH=y
CONFIG_QCOM_RPMHPD=y
CONFIG_QCOM_CMD_DB=y
CONFIG_QCOM_RSC_CTRL=y
CONFIG_ARM_SMMU=y
CONFIG_ARM_SMMU_QCOM=y

# --- GCC / clock controllers ---
CONFIG_QCOM_GCC_SC8180X=y
CONFIG_QCOM_GPUCC_SC8180X=y
CONFIG_QCOM_DISPCC_SC8180X=y

# --- Power management ---
CONFIG_PM=y
CONFIG_PM_GENERIC_DOMAINS=y
CONFIG_PM_GENERIC_DOMAINS_OF=y
CONFIG_QCOM_RPMH_REGULATOR=y

# --- UFS storage ---
CONFIG_SCSI=y
CONFIG_SCSI_UFSHCD=y
CONFIG_SCSI_UFSHCD_PLATFORM=y
CONFIG_SCSI_UFS_QCOM=y
CONFIG_BLK_DEV_SD=y

# --- USB ---
CONFIG_USB=y
CONFIG_USB_XHCI_HCD=y
CONFIG_USB_DWC3=y
CONFIG_USB_DWC3_QCOM=y
CONFIG_USB_STORAGE=y
CONFIG_USB_HID=y

# --- PHY ---
CONFIG_GENERIC_PHY=y
CONFIG_PHY_QCOM_QMP=y
CONFIG_PHY_QCOM_QMP_UFS=y
CONFIG_PHY_QCOM_QMP_USB=y
CONFIG_PHY_QCOM_SNPS_FEMTO_V2=y
CONFIG_PHY_QCOM_USB_HS=y

# --- Serial / UART ---
CONFIG_SERIAL_8250=y
CONFIG_SERIAL_8250_CONSOLE=y
CONFIG_SERIAL_MSM=y
CONFIG_SERIAL_MSM_CONSOLE=y
CONFIG_QCOM_GENI_SERIAL=y
CONFIG_SERIAL_DEV_CTRL=y

# --- I2C (keyboard, touchpad, touchscreen) ---
CONFIG_I2C=y
CONFIG_I2C_QCOM_GENI=y

# --- Pin control ---
CONFIG_PINCTRL=y
CONFIG_PINCTRL_QCOM=y
CONFIG_PINCTRL_SC8180X=y

# --- GPIO ---
CONFIG_GPIOLIB=y
CONFIG_GPIO_SYSFS=y

# --- Interrupt controller ---
CONFIG_QCOM_PDC=y
CONFIG_QCOM_MPM=y

# --- Interconnect ---
CONFIG_INTERCONNECT=y
CONFIG_INTERCONNECT_QCOM=y
CONFIG_INTERCONNECT_QCOM_OSM_L3=y
CONFIG_INTERCONNECT_QCOM_SC8180X=y

# --- Reset ---
CONFIG_RESET_QCOM_AOSS=y
CONFIG_RESET_QCOM_PDC=y

# --- Thermal ---
CONFIG_THERMAL=y
CONFIG_QCOM_TSENS=y

# --- Display / GPU (Phase 2, but enable basics) ---
CONFIG_DRM=y
CONFIG_DRM_MSM=y
CONFIG_DRM_PANEL_EDP=y
CONFIG_DRM_PANEL_BOE_TV101WUM_NL6=y
CONFIG_FB=y
CONFIG_FRAMEBUFFER_CONSOLE=y
CONFIG_EFI_FB=y
CONFIG_SIMPLE_FB=y

# --- WiFi (ath11k, Phase 3) ---
CONFIG_ATH11K=m
CONFIG_ATH11K_PCI=m

# --- Regulator ---
CONFIG_REGULATOR=y
CONFIG_REGULATOR_QCOM_RPMH=y
CONFIG_REGULATOR_VCTRL=y

# --- Remoteproc (needed for WiFi/modem firmware loading) ---
CONFIG_REMOTEPROC=y
CONFIG_QCOM_Q6V5_MSS=m
CONFIG_QCOM_Q6V5_PAS=m

# --- SOC ---
CONFIG_QCOM_SMEM=y
CONFIG_QCOM_SMP2P=y
CONFIG_QCOM_SMSM=y
CONFIG_QCOM_SOCINFO=y

# --- MTD (for UFS) ---
CONFIG_MTD=y

# --- Filesystems ---
CONFIG_EXT4_FS=y
CONFIG_VFAT_FS=y
CONFIG_TMPFS=y
CONFIG_PROC_FS=y
CONFIG_SYSFS=y
CONFIG_DEVTMPFS=y
CONFIG_DEVTMPFS_MOUNT=y

# --- EFI ---
CONFIG_EFI=y
CONFIG_EFI_STUB=y
CONFIG_EFI_PARAMS_FROM_FDT=y
CONFIG_EFI_RUNTIME_WRAPPERS=y
CONFIG_FB_EFI=y

# --- Kernel hacking ---
CONFIG_MAGIC_SYSRQ=y
CONFIG_DEBUG_FS=y
CONFIG_DETECT_HUNG_TASK=y
CONFIG_DEFAULT_HUNG_TASK_TIMEOUT=120

# --- Compression ---
CONFIG_RD_GZIP=y
CONFIG_RD_ZSTD=y

# --- Initramfs ---
CONFIG_BLK_DEV_INITRD=y

# --- Misc ---
CONFIG_NET=y
CONFIG_PACKET=y
CONFIG_UNIX=y
CONFIG_INET=y
CONFIG_MODULE_UNLOAD=y
CONFIG_MODULES=y
CONFIG_MODULE_FORCE_LOAD=y
CONFIG_MODULE_FORCE_UNLOAD=y
```
